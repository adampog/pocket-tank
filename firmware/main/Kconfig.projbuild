## firmware/main/Kconfig.projbuild
```kconfig
menu "pocket-tank"
    config POCKET_TANK_DISPLAY_SH8601
        bool "Drive the Waveshare 1.8in AMOLED (SH8601 / CO5300 over QSPI)"
        default n
        help
            Enable for the real board. Off = stub display port (QEMU / compile-only).
    config POCKET_TANK_ROUND
        bool "The ROUND build: a 466 px bowl for the Waveshare ESP32-S3-Touch-AMOLED-1.75C"
        default n
        help
            The tank's world is compiled in: off = the 448x368 rectangle (the
            1.8 board; on a 1.75C that image still runs, the frame shown inside
            the circle). On = TANK_ROUND, the bowl that fills the round glass;
            that image shows nothing on a 1.8. Build it with
            SDKCONFIG_DEFAULTS="sdkconfig.defaults;sdkconfig.round" into its
            own build directory and sdkconfig (docs/board-amoled-1.75c.md).
    config POCKET_TANK_WATCH
        bool "The WATCH build: a 410x502 PORTRAIT tank for the Waveshare ESP32-S3-Touch-AMOLED-2.06"
        default n
        depends on !POCKET_TANK_ROUND
        help
            On = TANK_WATCH: a tall tank the way a watch is worn, with the
            round corners of its glass; that image shows nothing on the
            other boards. Off, the 448x368 rectangle image still runs on a
            watch, on its side and centred in the glass. Build it with
            SDKCONFIG_DEFAULTS="sdkconfig.defaults;sdkconfig.watch" into its
            own build directory and sdkconfig (docs/board-amoled-2.06-watch.md).
    config POCKET_TANK_SQUARE
        bool "The SQUARE build: a 480x480 tank for the Waveshare ESP32-S3-Touch-AMOLED-2.16"
        default n
        depends on !POCKET_TANK_ROUND && !POCKET_TANK_WATCH
        help
            On = TANK_SQUARE: the tank fills the 2.16's square glass; that
            image shows nothing on the other boards. Build it with
            SDKCONFIG_DEFAULTS="sdkconfig.defaults;sdkconfig.square" into its
            own build directory and sdkconfig (docs/board-amoled-2.16.md).
    config POCKET_TANK_CYD28
        bool "The CYD build (this fork): the 2.8in ESP32-S3 CYD, ES3C28P - ILI9341 + FT6336, 320x240"
        default n
        depends on !POCKET_TANK_ROUND && !POCKET_TANK_WATCH && !POCKET_TANK_SQUARE && !POCKET_TANK_P4
        help
            On = TANK_CYD28: the rectangle's own 448x368 world (nothing in
            common/ is laid out for this glass), shown on the CYD's 320x240
            panel by the display port's area-filtered downscale
            (display_port_spi.c, qvga_scale.h); touches come back through the
            same scale. Its own board id (version.h PT_BOARD "cyd28"): it never
            takes another board's update. Build it with
            SDKCONFIG_DEFAULTS="sdkconfig.defaults;sdkconfig.cyd" into its own
            build directory (tools/build_cyd.sh, docs/CYD.md).
    config POCKET_TANK_TLCD2
        bool "The LCD-2 build (this fork): the Waveshare ESP32-S3-Touch-LCD-2 - ST7789T3 + CST816D, 320x240"
        default n
        depends on !POCKET_TANK_ROUND && !POCKET_TANK_WATCH && !POCKET_TANK_SQUARE && !POCKET_TANK_P4 && !POCKET_TANK_CYD28
        help
            On = TANK_TLCD2: as the CYD build, on the Touch-LCD-2 (PT_BOARD
            "tlcd2"). SDKCONFIG_DEFAULTS="sdkconfig.defaults;sdkconfig.tlcd2"
            (tools/build_tlcd2.sh).
    config POCKET_TANK_DISPLAY_QVGA_SPI
        bool "Drive a 320x240 SPI panel (the CYD's ILI9341, the LCD-2's ST7789), the frame scaled down to it"
        default n
        depends on POCKET_TANK_CYD28 || POCKET_TANK_TLCD2
    config POCKET_TANK_P4
        bool "The HOME TANK build: a 640x400 tank shown at 2x on the Waveshare ESP32-P4-WIFI6-Touch-LCD-10.1"
        default n
        depends on IDF_TARGET_ESP32P4
        help
            On = TANK_P4: the rectangle's world a half again as wide, drawn 2x
            by the P4's PPA onto its 1280x800 IPS glass. Its own target (an
            ESP32-P4, ESP-IDF 5.5): tools/flash_p4.sh builds it with
            SDKCONFIG_DEFAULTS="sdkconfig.defaults;sdkconfig.p4" into its own
            build directory (docs/board-p4-10.1.md).
    config POCKET_TANK_TAB5
        bool "The SMALL HOME TANK: the P4 home tank build on the M5Stack Tab5 (5in 1280x720)"
        default n
        depends on POCKET_TANK_P4
        help
            On = TANK_TAB5 beside TANK_P4: the home tank's world 720 tall, the
            Tab5's ST7121 / ST7123 / ILI9881C panel, its touch, its PI4IOE5V6408
            expanders. tools/flash_tab5.sh builds it with
            SDKCONFIG_DEFAULTS="sdkconfig.defaults;sdkconfig.p4;sdkconfig.tab5"
            (docs/board-tab5.md).
    config POCKET_TANK_P4_LCD7
        bool "BETA: the home tank on the Waveshare ESP32-P4-WIFI6-Touch-LCD-7 (7in 720x1280, ILI9881C)"
        default n
        depends on POCKET_TANK_P4 && !POCKET_TANK_TAB5
        help
            On = TANK_P4_LCD7 + TANK_TAB5's 720-tall world: the 10.1's board
            (pins, codec, touch chip, console) with Waveshare's 7 inch panel -
            an ILI9881C at 1000 Mbps a lane and its panel controller at I2C
            0x45. Untried on a board (nobody here owns one): BETA.
            tools/flash_p4_beta.sh 7 builds it with
            SDKCONFIG_DEFAULTS="sdkconfig.defaults;sdkconfig.p4;sdkconfig.p4lcd7"
            (docs/board-p4-7-8-beta.md). Not the -7B (1024x600): another board.
    config POCKET_TANK_P4_LCD8
        bool "BETA: the home tank on the Waveshare ESP32-P4-WIFI6-Touch-LCD-8 (8in 800x1280, JD9365)"
        default n
        depends on POCKET_TANK_P4 && !POCKET_TANK_TAB5 && !POCKET_TANK_P4_LCD7
        help
            On = TANK_P4_LCD8: the 10.1's image with the 8 inch panel's own
            JD9365 init table (Waveshare's BSP). Untried on a board: BETA.
            tools/flash_p4_beta.sh 8 (docs/board-p4-7-8-beta.md).
    config POCKET_TANK_DISPLAY_JD9365
        bool "Drive the Waveshare 10.1in IPS (JD9365 over MIPI-DSI, the P4 home tank)"
        default n
        depends on IDF_TARGET_ESP32P4
    config POCKET_TANK_NO_RADIO
        bool "No radio in this image: the network and link ports are stubs"
        default n
        help
            The P4's radio is a C6 over esp-hosted, not the esp_wifi driver:
            until that path is in, its image carries no Wi-Fi (no update
            page, no tank link, no internet time). Every port still answers.
    config POCKET_TANK_RADIO_HOSTED
        bool "The P4's radio: the C6 beside it through esp_hosted, the tank link through our relay"
        default n
        depends on IDF_TARGET_ESP32P4
        help
            The home tank WITH its radio chip (docs/board-p4-10.1.md, "The
            radio"): link_port_hosted.c speaks ESP-NOW through the C6's
            relay (firmware-c6/). The network port is still the stub. Built
            by tools/flash_p4.sh --radio (PT_P4_RADIO=1 brings the hosted
            components into the build; sdkconfig.p4radio sets this).
    config POCKET_TANK_CONSOLE_UART
        bool "The director console on UART0 instead of the USB serial port"
        default n
        help
            The P4 board's native USB port is not wired to its Type-C: the
            bench talks over the CH343 UART bridge (UART0, 115200).
    config POCKET_TANK_TOUCH_FT3168
        bool "Read the FT3168 capacitive touch (taps / holds)"
        default n
    config POCKET_TANK_AUDIO_ES8311
        bool "Play the sound bank through the ES8311 codec + NS4150B amp (I2S)"
        default n
        help
            Enable for the real board (docs/AUDIO.md). Off = stub audio port: cues compile, nothing plays.
    config POCKET_TANK_IMU_MPU6050
        bool "Look for an MPU-6050 IMU (I2C 0x68 / 0x69)"
        default y if POCKET_TANK_CYD28
        default n
        help
            The CYD has no IMU of its own; an MPU-6050 breakout on its I2C
            socket stands in (docs/CYD.md). Probed after the QMI8658
            (imu_port_qmi8658.c), so a board carrying both uses the QMI8658.
    config POCKET_TANK_IMU_MPU6050_UP_AXIS
        int "MPU-6050: the axis along the screen's up (0=X 1=Y 2=Z)"
        range 0 2
        default 1
        depends on POCKET_TANK_IMU_MPU6050
        help
            A bench fact, because the breakout is mounted by hand: hold the
            board right side up and run the director's `imu`; the axis
            carrying about 16000 counts is this one.
    config POCKET_TANK_IMU_MPU6050_UP_NEGATIVE
        bool "MPU-6050: that axis reads negative when held right side up"
        default n
        depends on POCKET_TANK_IMU_MPU6050
    config POCKET_TANK_IMU_MPU6050_OUT_AXIS
        int "MPU-6050: the axis out of the glass (0=X 1=Y 2=Z)"
        range 0 2
        default 2
        depends on POCKET_TANK_IMU_MPU6050
        help
            The axis that carries gravity when the board lies flat on its
            back. The flip ignores it: lying flat holds the last orientation.
    config POCKET_TANK_IMU_MPU6050_OUT_NEGATIVE
        bool "MPU-6050: that axis reads negative lying flat, screen up"
        default n
        depends on POCKET_TANK_IMU_MPU6050
        help
            Only the face-down gesture uses it: lying screen down reads the
            other sign.
    config POCKET_TANK_IMU_AUTO_FLIP
        bool "The IMU turns the picture over when the board is turned over"
        default y
        depends on !POCKET_TANK_IMU_FACE_DOWN_SLEEP
        help
            Off: the IMU only senses handling (the tank light, the codec's
            warm-up), and the settings page's SCREEN row alone says which
            way up the picture is. The face-down gesture's builds always
            let the IMU turn the picture.
    config POCKET_TANK_IMU_FACE_DOWN_SLEEP
        bool "Face down sleeps the tank, face up wakes it (a settings toggle)"
        default y if POCKET_TANK_CYD28
        default n
        help
            Screen down and still for 2 s is a short press of the sleep key;
            turned face up within the 20-minute grace, the tank wakes in place.
            The compact settings page's SCREEN row becomes FACE DOWN SLEEP /
            IGNORE once an IMU answers (the IMU turns the picture itself).
    config POCKET_TANK_NO_PIE
        bool "Disable the PIE SIMD inference kernel (scalar dot products)"
        default n
        help
            Enable for a QEMU build if the emulator lacks ESP32-S3 PIE support.
endmenu
```
